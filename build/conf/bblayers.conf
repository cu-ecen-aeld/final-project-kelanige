## build/conf/bblayers.conf
```bitbake
# POKY_BBLAYERS_CONF_VERSION is increased each time build/conf/bblayers.conf
# changes incompatibly
POKY_BBLAYERS_CONF_VERSION = "2"

BBPATH = "${TOPDIR}"
BBFILES ?= ""

BBLAYERS ?= " \
  /home/kri/Projects/ECEA5307/final-project/poky/meta \
  /home/kri/Projects/ECEA5307/final-project/poky/meta-poky \
  /home/kri/Projects/ECEA5307/final-project/poky/meta-yocto-bsp \
  /home/kri/Projects/ECEA5307/final-project/meta-raspberrypi \
  /home/kri/Projects/ECEA5307/final-project/meta-openembedded/meta-oe \
  /home/kri/Projects/ECEA5307/final-project/meta-openembedded/meta-multimedia \
  /home/kri/Projects/ECEA5307/final-project/meta-openembedded/meta-networking \
  /home/kri/Projects/ECEA5307/final-project/meta-openembedded/meta-python \
  /home/kri/Projects/ECEA5307/final-project/meta-ecearpi \
  "
```

## meta-ecearpi/conf/layer.conf
```bitbake
# We have a conf and classes directory, add to BBPATH
BBPATH .= ":${LAYERDIR}"

# We have recipes-* directories, add to BBFILES
BBFILES += "${LAYERDIR}/recipes-*/*/*.bb \
            ${LAYERDIR}/recipes-*/*/*.bbappend"

BBFILE_COLLECTIONS += "ecearpi"
BBFILE_PATTERN_ecearpi = "^${LAYERDIR}/"
BBFILE_PRIORITY_ecearpi = "6"

LAYERDEPENDS_ecearpi = "core"
LAYERSERIES_COMPAT_ecearpi = "mickledore"
```
